## kernel/Kconfig
```kconfig
menu "KernelSU"

config KSU
	tristate "KernelSU function support"
	depends on EXT4_FS
	default y
	help
	  Enable kernel-level root privileges on Android System.
	  Requires CONFIG_EXT4_FS for `ext4_unregister_sysfs`.
	  Use KSU_KPROBES_HOOK on GKI kernels with kprobe support, or
	  KSU_MANUAL_HOOK for legacy/non-GKI integrations.
	  To compile as a module, choose M here: the
	  module will be called kernelsu.

config KSU_DEBUG
	bool "KernelSU debug mode"
	depends on KSU
	default n
	help
	  Enable KernelSU debug mode.

config KSU_DISABLE_MANAGER
	bool "Disable KernelSU manager integration"
	depends on KSU
	default n
	help
	  Disable manager APK detection and manager-specific handling.
	  Root will be used in place of manager-only functionality.

config KSU_DISABLE_POLICY
	bool "Disable KernelSU policy profiles"
	depends on KSU
	default n
	help
	  Disable per-app root/non-root profile customization.
	  Escalation will always use the default full root profile, and
	  non-root handling will follow the global umount policy only.

# For easier extern ifdef handling
config KSU_MANUAL_HOOK
	bool "KernelSU manual hook mode."
	depends on KSU && KSU != m
	default y if !KPROBES
	default n
	help
	  Enable manual hook support.

config KSU_KPROBES_HOOK
	bool "KernelSU tracepoint+kretprobe hook"
	depends on KSU && !KSU_MANUAL_HOOK
	depends on KRETPROBES && KPROBES && HAVE_SYSCALL_TRACEPOINTS
	default y if KPROBES && KRETPROBES && HAVE_SYSCALL_TRACEPOINTS
	default y if !KSU_MANUAL_HOOK
	help
	  Enable KPROBES, KRETPROBES and TRACEPOINT hook for KernelSU core.
	  This should not be used on kernel below 5.10.

endmenu
```
